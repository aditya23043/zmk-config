## boards/shields/cradio/Kconfig.defconfig
```kconfig
if SHIELD_CRADIO_DONGLE

# Max 16 characters in keyboard name
config ZMK_KEYBOARD_NAME
    default "Cradio"

config ZMK_SPLIT_ROLE_CENTRAL
    default y

config ZMK_SPLIT
    default y

# Ferris Sweep has 2 halves (left + right)
config ZMK_SPLIT_BLE_CENTRAL_PERIPHERALS
    default 2

# 2 peripherals + 5 BT profiles = 7
config BT_MAX_CONN
    default 7

config BT_MAX_PAIRED
    default 7

endif
```

## boards/shields/cradio/Kconfig.shield
```kconfig
# No whitespace after comma or in keyboard name!
config SHIELD_CRADIO_DONGLE
    def_bool $(shields_list_contains,cradio_dongle)
```
